## boards/shields/ace/Kconfig.defconfig
```kconfig
if SHIELD_ACE_LEFT || SHIELD_ACE_RIGHT

config ZMK_KEYBOARD_NAME
    default "ACE"

config BT_MAX_CONN
    default 6

config BT_MAX_PAIRED
    default 6

endif
```

## boards/shields/ace/Kconfig.shield
```kconfig
config SHIELD_ACE_LEFT
    def_bool $(shields_list_contains,ace_left)

config SHIELD_ACE_RIGHT
    def_bool $(shields_list_contains,ace_right)
```

## boards/shields/tessera/Kconfig.defconfig
```kconfig
if SHIELD_TESSERA_LEFT || SHIELD_TESSERA_RIGHT

config ZMK_KEYBOARD_NAME
    default "Tessera"

endif
```

## boards/shields/tessera/Kconfig.shield
```kconfig
config SHIELD_TESSERA_LEFT
    def_bool $(shields_list_contains,tessera_left)

config SHIELD_TESSERA_RIGHT
    def_bool $(shields_list_contains,tessera_right)
```

## boards/shields/thecardv2/Kconfig.defconfig
```kconfig
if SHIELD_THECARDV2

config ZMK_KEYBOARD_NAME
    default "TheCardV2"

endif # SHIELD_THECARDV2
```

## dts/bindings/behaviors/zmk,behavior-ace-chord.yaml
```yaml
description: ACE side-local chord resolver

compatible: "zmk,behavior-ace-chord"

include: two_param.yaml

properties:
  timeout-ms:
    type: int
    required: true
```

## dts/bindings/behaviors/zmk,behavior-side-layer.yaml
```yaml
# SPDX-License-Identifier: MIT

description: Side-local persistent layer switch behavior

compatible: "zmk,behavior-side-layer"

include: one_param.yaml

properties:
  left-layers:
    type: array
    required: true
    description: Persistent layers owned by the left side. First entry is the side base layer.
  right-layers:
    type: array
    required: true
    description: Persistent layers owned by the right side. First entry is the side base layer.
```

## dts/bindings/behaviors/zmk,behavior-superkey.yaml
```yaml
# SPDX-License-Identifier: MIT

description: Hold modifier, tap one-shot, double tap lock behavior

compatible: "zmk,behavior-superkey"

include: one_param.yaml

properties:
  tapping-term-ms:
    type: int
    default: 150
  double-tap-ms:
    type: int
    default: 250
  release-after-ms:
    type: int
    default: 3000
  tap-keycode:
    type: int
    default: 0
    description: Encoded HID keycode to tap on single tap instead of using one-shot behavior.
```
